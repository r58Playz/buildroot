## configs/terraos_jacuzzi_defconfig
```kconfig
BR2_aarch64=y
BR2_cortex_a73_a53=y
BR2_PACKAGE_GLIBC_KERNEL_COMPAT=y
BR2_GCC_VERSION_13_X=y
BR2_TOOLCHAIN_BUILDROOT_CXX=y
BR2_INIT_NONE=y
BR2_ROOTFS_MERGED_USR=y
# BR2_TARGET_GENERIC_GETTY is not set
BR2_SYSTEM_DEFAULT_PATH="/bin:/sbin:/usr/bin:/usr/sbin"
BR2_ROOTFS_OVERLAY="custom/overlay"
BR2_PACKAGE_BUSYBOX_SHOW_OTHERS=y
BR2_PACKAGE_BZIP2=y
BR2_PACKAGE_P7ZIP=y
BR2_PACKAGE_UNZIP=y
BR2_PACKAGE_ZIP=y
BR2_PACKAGE_E2FSPROGS=y
BR2_PACKAGE_E2FSPROGS_RESIZE2FS=y
BR2_PACKAGE_UNIONFS=y
BR2_PACKAGE_ZLIB=y
BR2_PACKAGE_LIBFUSE3=y
BR2_PACKAGE_NEOFETCH=y
BR2_PACKAGE_TAR=y
BR2_PACKAGE_UTIL_LINUX_BINARIES=y
BR2_PACKAGE_UTIL_LINUX_PARTX=y
BR2_PACKAGE_LESS=y
BR2_PACKAGE_NANO=y
BR2_PACKAGE_SQUASHFS_FUSE=y
BR2_PACKAGE_TERRAOS=y
BR2_TARGET_ROOTFS_TAR_ZSTD=y
```

## package/squashfs-fuse/Config.in
```kconfig
config BR2_PACKAGE_SQUASHFS_FUSE
	bool "squashfs-fuse"
	depends on BR2_TOOLCHAIN_HAS_THREADS # libfuse
	depends on BR2_USE_MMU # libfuse
	depends on !BR2_STATIC_LIBS # libfuse
	select BR2_PACKAGE_LIBFUSE
	select BR2_PACKAGE_GZIP
	select BR2_PACKAGE_XZ
	select BR2_PACKAGE_ZSTD
	help
	  A userspace squashfs implementation.

	  https://github.com/vasi/squashfuse

comment "squashfs-fuse needs a toolchain w/ threads, dynamic library"
	depends on BR2_USE_MMU
	depends on !BR2_TOOLCHAIN_HAS_THREADS || BR2_STATIC_LIBS
```

## package/terraos/Config.in
```kconfig
config BR2_PACKAGE_TERRAOS
	bool "terraos"
	depends on BR2_PACKAGE_HOST_RUSTC_TARGET_ARCH_SUPPORTS
	select BR2_PACKAGE_HOST_RUSTC
	help
	  Boot Linux-based operating systems from a RMA shim.

	  https://github.com/r58Playz/terraos
```
